/ {
    chosen {
        zmk,kscan = &kscan0;
    };

    /delete-node/ behaviors;   /* Intenta desactivar behaviors problemáticos */

    kscan0: kscan {
        compatible = "zmk,kscan-gpio-matrix";
        diode-direction = "col2row";

        row-gpios = <&gpio1 13 GPIO_ACTIVE_LOW>, <&gpio1 11 GPIO_ACTIVE_LOW>, <&gpio0 10 GPIO_ACTIVE_LOW>, <&gpio0 9 GPIO_ACTIVE_LOW>,
                    <&gpio1 6 GPIO_ACTIVE_LOW>, <&gpio1 4 GPIO_ACTIVE_LOW>, <&gpio0 11 GPIO_ACTIVE_LOW>, <&gpio1 0 GPIO_ACTIVE_LOW>;

        col-gpios = <&gpio0 31 GPIO_ACTIVE_HIGH>, <&gpio0 29 GPIO_ACTIVE_HIGH>, <&gpio0 2 GPIO_ACTIVE_HIGH>, <&gpio1 15 GPIO_ACTIVE_HIGH>;
    };
};